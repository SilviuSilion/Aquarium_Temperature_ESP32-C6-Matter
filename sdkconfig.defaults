## sdkconfig.defaults
```kconfig
# Matter Configuration
# Flash Size - ESP32-C6-LCD-1.47 has 8MB flash!
CONFIG_ESPTOOLPY_FLASHSIZE_8MB=y
CONFIG_ESPTOOLPY_FLASHSIZE="8MB"

# FreeRTOS - Matter needs specific settings
CONFIG_FREERTOS_HZ=100

# LVGL Fonts - All enabled
CONFIG_LV_FONT_MONTSERRAT_14=y
CONFIG_LV_FONT_MONTSERRAT_16=y
CONFIG_LV_FONT_MONTSERRAT_20=y
CONFIG_LV_FONT_MONTSERRAT_24=y
CONFIG_LV_FONT_MONTSERRAT_28=y
CONFIG_LV_FONT_MONTSERRAT_32=y
CONFIG_LV_FONT_MONTSERRAT_36=y
CONFIG_LV_FONT_MONTSERRAT_48=y

# Matter Stack Size
CONFIG_ESP_MAIN_TASK_STACK_SIZE=8192
CONFIG_ESP_SYSTEM_EVENT_TASK_STACK_SIZE=4096

# Partition - Matter needs bigger app partition
CONFIG_PARTITION_TABLE_CUSTOM=y
CONFIG_PARTITION_TABLE_CUSTOM_FILENAME="partitions.csv"
CONFIG_PARTITION_TABLE_FILENAME="partitions.csv"

# WiFi for Matter
CONFIG_ESP_WIFI_STATIC_RX_BUFFER_NUM=16
CONFIG_ESP_WIFI_DYNAMIC_RX_BUFFER_NUM=32
CONFIG_ESP_WIFI_DYNAMIC_TX_BUFFER_NUM=32

# Matter Protocol
CONFIG_ENABLE_CHIP_SHELL=n
CONFIG_OPENTHREAD_ENABLED=n

# mbedTLS - Matter needs HKDF!
CONFIG_MBEDTLS_HKDF_C=y

# Matter Device Info - Claude&Silviu Senzor Apa
CONFIG_DEVICE_VENDOR_NAME="Claude&Silviu"
CONFIG_DEVICE_PRODUCT_NAME="Senzor Apa"
CONFIG_DEVICE_SERIAL_NUMBER="AQ-TEMP-001"
CONFIG_DEVICE_HARDWARE_VERSION=1
CONFIG_DEVICE_HARDWARE_VERSION_STRING="1.0"
CONFIG_DEVICE_SOFTWARE_VERSION=1
CONFIG_DEVICE_SOFTWARE_VERSION_STRING="1.0.0"
```
